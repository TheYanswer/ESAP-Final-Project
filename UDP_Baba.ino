
#define hF 19
#define hC  18
#define Bb 17
#define F 16
#define dampener 5
#define strikeconstant   30  //in ms

#include <WiFi.h>
#include <WiFiUdp.h>

bool looper = false;                             

const char* ssid     = "modlab1";
const char* password = "ESAP2017";

WiFiUDP UDPTestServer;
unsigned int UDPPort = 2808;
IPAddress myIPaddress(192, 168, 1, 60);

const int packetSize = 10;

byte packetBuffer[packetSize];

int counter = 1;

const float playmoment[] = {0, 50.08694,51.65216,52.1739,54.26086,55.82607,56.34781,58.43477,59.99999,60.52172,62.60868,64.1739,64.69564,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302.338,302.4926};
const float note[] = {0, 174.5,130.5,116.54,174.5,130.5,116.54,174.5,130.5,116.54,174.5,130.5,116.54,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130.5,130.5};

void setup()  {
  pinMode(18, OUTPUT);
  pinMode(19, OUTPUT);
  pinMode(17, OUTPUT);
  pinMode(5 , OUTPUT);
  pinMode(16, OUTPUT);
  Serial.begin(115200);
  Serial.println();
  Serial.print("Connecting to ");   Serial.println(ssid);

  WiFi.begin(ssid, password);
  WiFi.config(myIPaddress, IPAddress(192, 168, 1, 1),
              IPAddress(255, 255, 255, 0));

  while (WiFi.status() != WL_CONNECTED) {
    delay(500);
    Serial.print(".");
  }

  Serial.println("WiFi connected");
  Serial.println("WiFi connected");

  UDPTestServer.begin(UDPPort);
}
void playnote()
{
  if (counter < 500)
  {
    int waittime = (playmoment[counter] * 1000) - (playmoment[counter - 1] * 1000);
    Serial.println(float(note[counter]));
    Serial.print("waiting ");
    Serial.println(waittime - strikeconstant);
    delay(waittime - strikeconstant);
    if ((note[counter] > 174 && note[counter] < 175) || (note[counter] > 348 && note[counter] < 350)) { //playing high f
      Serial.println("High F");
      digitalWrite( hF, HIGH);
      delay(strikeconstant);
      digitalWrite( hF, LOW);
    }
    else if (note[counter] > 116 && note[counter] < 117  || (note[counter] > 58 && note[counter] < 59)  || (note[counter] > 232 && note[counter] < 233)) { //playing Bb
      Serial.println("Bb");
      digitalWrite( Bb, HIGH);
      delay(strikeconstant);
      digitalWrite( Bb, LOW);
    }
    else if (note[counter] > 130 && note[counter] < 131  || (note[counter] > 65 && note[counter] < 67) || (note[counter] > 260 && note[counter] < 262)) { //playing high C
      Serial.println("High C");
      digitalWrite( hC, HIGH);
      delay(strikeconstant);
      digitalWrite( hC, LOW);
    }
    else if (note[counter] > 87 && note[counter] < 88 ) { //playing F
      Serial.println("F");
      digitalWrite( F, HIGH);
      delay(strikeconstant);
      digitalWrite( F, LOW);
    }
    else {
    }
    //    delay((hold[counter]*1000)-dampenerconstant);
    //    dampen();
    counter ++;
    Serial.println(counter);
  }
}
void loop() {
  handleUDPServer();
  delay(1);
}

void handleUDPServer() {
  if (looper == true) {
    playnote();
  }
  int cb = UDPTestServer.parsePacket();
  if (cb) {
    UDPTestServer.read(packetBuffer, packetSize);
    String myData = "";
    for (int i = 0; i < packetSize; i++) {
      myData += (char)packetBuffer[i];
    }
    Serial.print(millis()); Serial.print(", ");
    Serial.println (myData);
    if (myData == "A") {
      looper = true;
      Serial.println();

    }
  }
}
